## kernel/linux/drivers/char/kcci_ledkey/Kconfig
```kconfig
menu "kcci gpio test device driver"
	depends on ARM
	config KCCI_LEDKEY
	tristate "kcci ledkey device driver"
	help
	sample driver for ledkey device
endmenu
```
